/*
 * ssd1306.c
 *
 *  Created on: Dec 20, 2020
 *      Author: koutakimura
 */
 
 #include "MYLIB.h"
 

/**-------------------------------------------------
 * 数値を文字列に変換する関数
 * ------------------------------------------------
 * change_data	: 文字列に変換を行うデータを指定
 * -------------
 * buff			: データを保存する配列の先頭アドレスを指定
 * -------------------------------------------------*/
void ascii_change(int32_t disp_data, char *buff, uint8_t len)
{
	uint16_t div, r;

	do {
		div = disp_data;
		disp_data /= 10;
		r = div - disp_data*10U;
		*buff = '0'+r;
		buff++;
	} while(disp_data > 0);

	*buff = '\0';
}


/**-------------------------------------------------
 * 文字列配列のデータを入れ替える
 * -------------------------------------------------
 * *s1		: 入れ替え先の配列
 * ---------
 * *s2		: 入れ替え元の配列
 * -------------------------------------------------*/
void s_exchange(char *s1, char *s2)
{
	char *p;
	uint8_t n;

	n = s_len(s2);	//文字数確保
	p = s1+n-1;		//ヌル文字の手前までアドレス移動

	while (*s2) {
		*p-- = *s2++;	//先頭アドレスから値保持
	}
	*(s1+n) = '\0';		//末尾にヌル文字格納
}


/**-------------------------------------------------
 * 文字列の長さを取得
 * -------------------------------------------------
 * *s		: 文字データが保存されている配列のアドレスを指定
 * -------------------------------------------------*/
uint8_t s_len(char *s)
{
	uint8_t count = 0;

	while (*s++) {
		count++;
	}
	return count;
}


/**------------------------------------------------- 
 * 指定した配列に文字列をコピーする
 * -------------------------------------------------
 * *s1		: コピー先の配列
 * ---------
 * *s2		: コピー元の配列
 * -------------------------------------------------*/
void s_copy(char *s1, char *s2)
{
	while (*s2) {
		*s1++ = *s2++;
	}
	*s1 = '\0';
}


/**-------------------------------------------------
 * 指定した配列のアドレスに一文字格納する関数
 * -------------------------------------------------
 * *s1		: 挿入先の配列のアドレスを指定
 * ---------
 * n		: 挿入先の配列の番地を指定
 * ---------
 * s		: 文字データ
 * -------------------------------------------------*/
void s_number_push(char *s1, uint8_t n, char s)
{
	char *p;

	p = s1+n;
	*p = s;
}


/**-------------------------------------------------
 * 指定した配列のアドレスから順番にデータを格納する関数
 * -------------------------------------------------
 * *s1		:コピーを行うデータが格納された配列
 * ---------
 * *s2		:コピー先の配列
 * ---------
 * n		:コピー元アドレス指定
 * ---------
 * m		:コピー先アドレス指定
 * -------------------------------------------------*/
void s_cp(char *s1, char *s2, uint8_t n, uint8_t m)
{
	char *p, *ptr;

	ptr = s2+m;
	p = s1+n;
	s_copy(ptr, p);
}
