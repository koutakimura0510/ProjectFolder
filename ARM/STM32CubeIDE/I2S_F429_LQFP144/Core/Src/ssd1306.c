/*
 * ssd1306.c
 *
 *  Created on: Dec 20, 2020
 *      Author: koutakimura
 */


/**-------------------------------------------------
 * Include ファイル
 * -------------------------------------------------*/
#include "MYLIB.h"
#include "stm32f4xx_hal.h"


/**-------------------------------------------------
 * 構造体要素数
 * -------------------------------------------------*/
#define PARAMATE ((sizeof (fontpara))/(sizeof (t_lcdfont)))


/**-------------------------------------------------
 * LCD フレームバッファ
 * -------------------------------------------------*/
#define MEMORY_ROW		8
#define MEMORY_COLUMN	128

static uint8_t memory[MEMORY_ROW*MEMORY_COLUMN];

///******************** font12.h ***********************

static const uint8_t fontdata12[][20] = {
		{0x00,0x00,0x00,0x00,0x00,0x00,0x00,0x00,0x00,0x00,0x00,0x00,0x00,0x00,0x00,0x00,0x00,0x00,0x00,0x00,}, // " " 0x20
		{0x00,0x00,0x00,0x00,0xFF,0xFF,0x00,0x00,0x00,0x00,0x00,0x00,0x00,0x00,0x0D,0x0D,0x00,0x00,0x00,0x00,},	// !
		{0x00,0x00,0x0F,0x0F,0x00,0x00,0x0F,0x0F,0x00,0x00,0x00,0x00,0x00,0x00,0x00,0x00,0x00,0x00,0x00,0x00,},	// "
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		{0x00,0x00,0x60,0x60,0xFC,0xFE,0x03,0x00,0x00,0x00,0x00,0x00,0x00,0x00,0x03,0x07,0x0C,0x00,0x00,0x00,},	// {
		//{0x00,0x00,0x00,0x00,0xFE,0xFE,0x00,0x00,0x00,0x00,0x00,0x00,0x00,0x00,0x07,0x07,0x00,0x00,0x00,0x00,},	// |
		//{0x00,0x00,0x00,0x03,0xFE,0xFC,0x60,0x60,0x00,0x00,0x00,0x00,0x00,0x0C,0x07,0x03,0x00,0x00,0x00,0x00,},	// }
		{0x00,0x00,0x80,0xF8,0x78,0x00,0x80,0xF8,0x78,0x00,0x00,0x06,0x03,0x07,0x06,0x06,0x03,0x07,0x04,0x00,},	// μ
		{0x00,0x0C,0x12,0xCC,0xE0,0x30,0x30,0x60,0x40,0x00,0x00,0x00,0x00,0x01,0x03,0x06,0x06,0x03,0x01,0x00,},	// °c

};


/**-------------------------------------------------
 * HAL I2C確保
 * -------------------------------------------------*/
I2C_HandleTypeDef hi2c1;



/**-------------------------------------------------
 * フォントデータの情報を管理する構造体
 * -------------------------------------------------
 * id		: IDを定義
 * ---------
 * w		: フォントデータの横幅を定義
 * ---------
 * h		: フォントデータの縦幅を定義
 * ---------
 * s_ascii	: フォントデータが保存されている配列の先頭文字データを定義
 * ---------
 * e_ascii	: フォントデータが保存されている配列の終端文字データを定義
 * ---------
 * *font	: フォントデータが保存されている配列の先頭アドレスを定義
 * -------------------------------------------------*/
typedef struct {
	uint8_t  id;
	uint8_t  w;
	uint8_t  h;
	char     s_ascii;
	uint16_t e_ascii;
	uint8_t  *font;
} t_lcdfont;


/**-------------------------------------------------
 * 構造体の確保
 * -------------------------------------------------*/
static const t_lcdfont fontpara[] = {
		{ IDFONT12,  FONT12_W,  FONT12_H, ' ' , '}'  , (uint8_t *)fontdata12 },
};



/**-------------------------------------------------
 * ファイル内関数
 * -------------------------------------------------*/
static void lcd_write(uint8_t cmd_data, uint8_t wr_data);
static void lcd_write_disp(uint8_t y_pos, uint8_t x_pos, uint8_t y_ini, uint8_t x_ini, uint8_t font_id, uint8_t *str);
static uint8_t *each_font_data(uint8_t font_id);
static uint8_t search_fontpara(uint8_t id, uint8_t member);
static char search_fontcol(uint8_t id, uint8_t member);
static bool i2c_send(uint8_t *dat, uint8_t address, uint8_t len);
static void lcd_disp(uint8_t x_pos, uint8_t y_pos, uint8_t x_ini, uint8_t w, uint8_t len, uint8_t string);
static void flame_buff_write(uint8_t x_pos, uint8_t y_pos, uint8_t y_ini, uint8_t w, uint8_t bitdata, uint8_t h, uint8_t count);
static uint8_t dot_buff_read(uint8_t y_pos, uint8_t x_pos);
static void dot_buff_overwrite(uint8_t y_pos, uint8_t x_pos, uint8_t dotdata);
static void page_pos(uint8_t x_pos, uint8_t count);
static void lcd_buff(uint8_t y_s, uint8_t x_s, uint8_t y_e, uint8_t x_e);
static void lcd_reverse(uint8_t y_s, uint8_t x_s, uint8_t y_e, uint8_t x_e, uint8_t blink);
static void frame_buff_clear(void);


/**-------------------------------------------------
 * I2C 送信
 * -------------------------------------------------
 * arg1:	送信データが保存されているアドレスを指定
 * arg2:	スレーブのアドレスを指定
 * arg3:	送信データのデータ長を指定
 * -------------------------------------------------*/
static bool i2c_send(uint8_t *dat, uint8_t address, uint8_t len)
{
	HAL_I2C_Master_Transmit(&hi2c1, address, dat, len, 100);

	return true;
}


/**-------------------------------------------------
 * LCDに10進数データの描画を行う
 * -------------------------------------------------
 * disp_data	: 表示させるデータの値を指定
 * -------------
 * y			: 開始y座標を指定
 * -------------
 * x			: 開始x座標を指定
 * -------------
 * yini			: 縦の文字間隔を指定
 * -------------
 * xini			: 横の文字間隔を指定、1だと1ドット空く
 * -------------------------------------------------*/
void lcd_hex_flash(int32_t disp_data, uint8_t y, uint8_t x, uint8_t yini, uint8_t xini)
{
    char wbuff[8];
    char copy[NUM(wbuff)];
    uint8_t len, w, h;
    	
	ascii_change(disp_data, wbuff, NUM(wbuff));
	s_exchange(copy, wbuff);	//反転した値が保持されるため反転格納
	s_copy(wbuff, copy);		//配列コピー

	len = s_len(wbuff);
	w = search_fontpara(IDFONT12, 'W');	//文字の幅を取得
	h = search_fontpara(IDFONT12, 'H');	//文字の高さを取得
	lcd_reverse(y, x, (y + h), (x + (w * len) + (xini * len)), 0x00);
	lcd_write_disp(y, x, yini, xini, IDFONT12, (uint8_t *)wbuff);
}


/**-------------------------------------------------
 * LCDにascii文字列の描画を行う
 * -------------------------------------------------
 * disp_data	: 表示させるデータの値を指定
 * -------------
 * y			: 開始y座標を指定
 * -------------
 * x			: 開始x座標を指定
 * -------------
 * yini			: 縦の文字間隔を指定
 * -------------
 * xini			: 横の文字間隔を指定、1だと1ドット空く
 * -------------------------------------------------*/
void lcd_ascii_flash(char *str, uint8_t y, uint8_t x, uint8_t yini, uint8_t xini)
{
    uint8_t len, w, h;

	len = s_len(str);
	w = search_fontpara(IDFONT12, 'W');	//文字の幅を取得
	h = search_fontpara(IDFONT12, 'H');	//文字の高さを取得
	lcd_reverse(y, x, (y + h), (x + (w * len) + (xini * len)), 0x00);
	lcd_write_disp(y, x, yini, xini, IDFONT12, (uint8_t *)str);
}


/**------------------------------------------------------
 * SSD1306 初期設定
 * ------------------------------------------------------*/
void lcd_init(void)
{
	static const uint8_t initial_table[] =
	{
		CONTRAST_SET,
		CONTRAST_VALUE,
		SER_SEGMENT_REMAP,
		CHARGE_PUMP,
		ENABLE_CHARGE_PUMP,
		SCAN_DIRECTION,
		SET_COM_PIN,
		PIN_HARD,
		SET_DISPLAY_CLOCK,
		OSCILLATOR_RATIO,
		SET_PERIOD,
		SET_DCLK,
		SET_VCOMH,
		VCOMH_LEVEL,
		DISPLAY_ON,
	};

	wait_time(3);

	for (uint8_t i = 0; i < NUM(initial_table); i++ ) {
		lcd_write(CMD_BYTE, initial_table[i]);
		wait_time(1);
	}
	lcd_clear();
}


/**-------------------------------------------------------
 * lcd 画面消去
 * -------------------------------------------------------*/
void lcd_clear(void)
{
	static const uint8_t clear_table[] =
	{
			SCROLL_STOP,
			MEMORY_MODE,
			HORIZONTAL_MODE,
			COLUMN_ADDRESS,
			COLUMN_START,
			COLUMN_END,
			PAGE_ADDRESS,
			PAGE_START,
			PAGE_END,
	};

	for (uint8_t i = 0; i < NUM(clear_table); i++) {
		lcd_write(CMD_BYTE, clear_table[i]);
	}

	for (uint16_t i = 0; i < MAX_DISP; i++) {
		lcd_write(WR_BYTE, CLEAR_DISP);
	}
}


/**-------------------------------------------------------
 * SSD1306 lcd データ送信
 * -------------------------------------------------------
 * cmd_data	: 設定コマンドの場合 = CMD_BYTEを指定　書き込みコマンドの場合 = WR_BYTEを指定
 * ---------
 * wr_data	: 1byteのデータを指定
 * -------------------------------------------------------*/
static void lcd_write(uint8_t cmd_data, uint8_t wr_data)
{
	static uint8_t wdat[2];

	wdat[0] = cmd_data;
	wdat[1] = wr_data;
	i2c_send(wdat, LCD_ADRRESS, NUM(wdat));
}


/**-------------------------------------------------------
 * フレームバッファに文字列を書き込む
 * -------------------------------------------------------
 * y_pos	: 始点y座標を指定
 * ---------
 * x_pos	: 始点x座標を指定
 * ---------
 * y_ini	: y軸の文字間隔を指定
 * ---------
 * x_ini	: x軸の文字間隔を指定
 * ---------
 * font_id	: データを表示させるフォントを指定
 * ---------
 * *str		: 表示させる文字データが保存されている、配列の先頭アドレスを指定
 * -------------------------------------------------------*/
static void lcd_write_disp(uint8_t y_pos, uint8_t x_pos, uint8_t y_ini, uint8_t x_ini, uint8_t font_id, uint8_t *str)
{
	char get_str, s_str;	//文字コード受信用
	uint8_t *fp;			//フォントデータの先頭アドレス取得用ポインタ
	uint8_t string, max_dispstr, len, bitdata, div, c_cnt, row, col, w, h, page;

	row     = y_pos;
	col     = x_pos;
	s_str   = search_fontcol(font_id, 'S');			//先頭文字データ数取得
	get_str = search_fontcol(font_id, 'E') - s_str;	//配列長を取得
	w 		= search_fontpara(font_id, 'W');		//文字の幅を取得
	h 		= search_fontpara(font_id, 'H');		//文字の高さを取得
	string 	= (MAX_CULUMN-x_pos)/(w+x_ini);			//列の最大表示文字数
	max_dispstr = ((MAX_HEIGHT-y_pos+y_ini)/(h+y_ini))*string;	//全体の表示可能文字数
	len 	= s_len((char *)str);					//文字数確保
	c_cnt 	= w * (((h - 1) / MAX_PAGE) + 1);		//１文字の処理回数
	page 	= h >> 3;								//１文字当たりの使用ページ数計算

	if ((h & 0x07) != 0) {
		page += 1;
	}

	if (len >= max_dispstr) {		//表示文字数チェック
		len = max_dispstr;
	}
	div = len/string;				//処理回数計算

	if (len - (string*div) != 0) {	//余りが出たら処理回数+1
		div += 1;
	}

	fp = each_font_data(font_id);		//フォントデータの先頭アドレス取得
	lcd_write(CMD_BYTE, MEMORY_MODE);	//LCDモード変更
	lcd_write(CMD_BYTE, PAGE_MODE);		//LCDを書き込みモードに変更

	for (uint8_t i = 0; i < div; i++) {
		for (uint8_t j = 0; j < len - (i * (string)) && j < string; j++) {	//1行あたりの処理
			for (uint8_t k = 0; k < c_cnt; k++) {							//1文字あたりの処理
				bitdata = fp[((get_str-(get_str-(*str-s_str)))*(page*w))+k];
				flame_buff_write(col+(j*w), row, y_ini, w, bitdata, h, k);
			}
			str++;				//文字列のアドレスを進める
			col = col+x_ini;	//次のｘ座標を指定
		}
		col = x_pos;			//ページが更新されたらｘ座標を戻す
		row = row+h+y_ini;		//次のｙ座標を指定
	}
	lcd_disp(x_pos, y_pos, x_ini, w, len, string);
}


/**-------------------------------------------------
 * フォントデータの先頭アドレスを取得
 * -------------------------------------------------
 * font_id	: 取得を行うフォントIDを指定
 * -------------------------------------------------*/
static uint8_t *each_font_data(uint8_t font_id)
{
	const t_lcdfont *p = fontpara;
	uint8_t *adr;

	for (uint8_t i = 0; i < PARAMATE; i++, p++) {
		if (p->id == font_id) {
			break;
		}
	}
	adr = p->font;

	return adr;
}


/**-------------------------------------------------
 * フォントデータの高さと幅を取得
 * -------------------------------------------------
 * id		: 取得を行うフォントIDを指定
 * -------------------------------------------------
 * member	: 'W' = 幅を取得 'H'高さを取得
 * -------------------------------------------------*/
static uint8_t search_fontpara(uint8_t id, uint8_t member)
{
	const t_lcdfont *p = fontpara;

	for (uint8_t i = 0; i < PARAMATE; i++, p++) {
		if (p->id == id) {
			break;
		}
	}

	switch (member) {
		case 'W':
			return p->w;

		case 'H':
			return p->h;
	}
	return 0;
}


/**------------------------------------------------- 
 * 列の大きさを返す関数
 * -------------------------------------------------
 * id		: フォントIDを指定
 * ---------
 * member	: 'S' = 開始文字を取得  'E' = 終了文字を取得
 * -------------------------------------------------*/
static char search_fontcol(uint8_t id, uint8_t member)
{
	const t_lcdfont *p = fontpara;

	for (uint8_t i = 0; i < PARAMATE; i++, p++) {
		if (p->id == id) {
			break;
		}
	}

	switch (member) {
		case 'S':
			return p->s_ascii;

		case 'E':
			return p->e_ascii;
	}
	return 0;
}



/**-------------------------------------------------
 * フレームバッファのデータを表示
 * ------------------------------------------------
 * x_pos	: 始点のx座標
 * ---------
 * y_pos	: 始点のy座標
 * ---------
 * x_ini	: x座標の文字間隔
 * ---------
 * w		: 文字の幅
 * ---------
 * len		: 表示文字数
 * ---------
 * string	: 行に表示する最大文字数
 * -------------------------------------------------*/
static void lcd_disp(uint8_t x_pos, uint8_t y_pos, uint8_t x_ini, uint8_t w, uint8_t len, uint8_t string)
{
	for (uint8_t i = y_pos >> 3; i < MAX_PAGE; i++) {
		page_pos(x_pos, i);									//座標の指定
		for (uint8_t j = 0; j < len && j < string; j++) {	//１行あたりの処理
			for (uint8_t k = 0; k < (w + x_ini); k++) {		//１文字あたりの処理(文字の横幅+文字間隔)
				lcd_write(WR_BYTE, dot_buff_read(i, x_pos + k + (j * (w + x_ini))));
			}
		}
	}
}


/**------------------------------------------------- 
 * フレームバッファに文字データを書き込む関数
 * -------------------------------------------------
 * x_pos	:現在のx座標
 * ---------
 * y_pos	:現在のy座標
 * ---------
 * y_ini	:列の文字間隔
 * ---------
 * w		:文字の幅
 * ---------
 * bitdata	:1バイト分のフォントデータ
 * ---------
 * h		:文字の高さ
 * ---------
 * count	:一文字の処理回数
 * -------------------------------------------------*/
static void flame_buff_write(uint8_t x_pos, uint8_t y_pos, uint8_t y_ini, uint8_t w, uint8_t bitdata, uint8_t h, uint8_t count)
{
	uint8_t row, col, page;

	page = y_pos >> 3;						//ページ数計算
	row  = page+(count / w);				//縦幅計算
	col  = x_pos+count-(w * (count / w));	//横幅計算

	if ((row > MAX_PAGE) || (col > MAX_CULUMN)){	//各最大値を超えたら書き込み終了
		return;
	}

	if (y_pos+h+y_ini > MAX_HEIGHT) {
		return;
	}
	memory[(row*MAX_CULUMN) + col] = (bitdata << (y_pos - (MAX_PAGE * page))) | dot_buff_read(row, col);	//前回のデータと｜したデータを格納
	memory[((row+1) * MAX_CULUMN) + col] |= bitdata >> (MAX_PAGE - (y_pos - (MAX_PAGE * page)));	//次ページにy_pos分シフトしたデータを格納
}


/**-------------------------------------------------
 * フレームバッファのデータを読み込む
 * -------------------------------------------------*/
static uint8_t dot_buff_read(uint8_t y_pos, uint8_t x_pos)
{
	return memory[(y_pos * MAX_CULUMN) + x_pos];
}


/**-------------------------------------------------
 * フレームバッファにデータを上書き
 * -------------------------------------------------*/
static void dot_buff_overwrite(uint8_t y_pos, uint8_t x_pos, uint8_t dotdata)
{
	memory[(y_pos * MAX_CULUMN) + x_pos] = dotdata;
}


/**-------------------------------------------------
 * フレームバッファをクリア
 * -------------------------------------------------*/
static void frame_buff_clear(void)
{
	for (uint8_t i = 0; i < MEMORY_ROW; i++) {	//最大配列文ループ
		for (uint8_t j = 0; j < MEMORY_COLUMN; j++) {
			dot_buff_overwrite(i, j, 0);
		}
	}
}


/**-------------------------------------------------
 * 描画する座標データをレジスタにセットする関数
 * ------------------------------------------------
 * x_pos	: 始点のx座標
 * ---------
 * count	: 描画ページ
 * -------------------------------------------------*/
static void page_pos(uint8_t x_pos, uint8_t count)
{
	lcd_write(CMD_BYTE, x_pos & COLUMN_BIT); //pageアドレスモードの場合4bitずつ上位と下位に分けて開始座標の設定を行う
	lcd_write(CMD_BYTE, ((x_pos >> 4) & COLUMN_BIT) | HI_COLUMN);
	lcd_write(CMD_BYTE, (count | PAGE_CMD));	//ページコマンドモードに設定
}


/**-------------------------------------------------
 * 選択した座標のデータを操作
 * -------------------------------------------------
 * y_s		: 始点のy座標
 * ---------
 * x_s		: 始点のx座標
 * ---------
 * y_e		: 終点のy座標
 * ---------
 * x_e		: 終点のx座標
 * ---------
 * blink	: 0x01反転表示 0x00クリア表示
 * -------------------------------------------------*/
static void lcd_reverse(uint8_t y_s, uint8_t x_s, uint8_t y_e, uint8_t x_e, uint8_t blink)
{
	uint8_t s_page, e_page, s_bit, e_bit, ys, ye, bit;

	ys = y_s;
	ye = y_e;
	s_page = ys >> 3;	//開始ページ
	e_page = ye >> 3;	//終了ぺージ
	ys &= 0x07;
	ye &= 0x07;
	bit = 0xff >> (8 - ys);
	ys = (0xff << ys) * blink;	//操作範囲を選択
	s_bit = (0xfe << ye);
	e_bit = ((0x01 << ye) - 1) * blink;

	for (uint8_t i = s_page + 1; i < e_page; i++) {	//3ページ以上使用する場合の中間ページ処理
		for (uint8_t j = x_s; j < x_e + 1; j++) {
			dot_buff_overwrite(i, j, (0xff * blink) & ~dot_buff_read(i, j));
		}
	}

	for (uint8_t i = x_s; i < x_e + 1; i++) {	//最初のページ処理
		dot_buff_overwrite(s_page, i, (bit & dot_buff_read(s_page, i)) | (ys & ~dot_buff_read(s_page, i)));
		dot_buff_overwrite(e_page, i, (s_bit & dot_buff_read(e_page, i)) | (e_bit & ~dot_buff_read(e_page, i)));
	}
	if (blink == 0x01) {
		lcd_buff(y_s, x_s, y_e, x_e);
	}
}


/**-------------------------------------------------
 * フレームバッファに格納されたデータを表示させる関数
 * -------------------------------------------------
 * y_s		: 開始ページ
 * ---------
 * x_s		: 始点のx座標
 * ---------
 * y_e		: 終了ページ
 * ---------
 * x_e		: 終点のx座標
 * -------------------------------------------------*/
static void lcd_buff(uint8_t y_s, uint8_t x_s, uint8_t y_e, uint8_t x_e)
{
	uint8_t n;

	if (y_s >= y_e) {
		n = y_e;
		y_e = y_s;
		y_s = n;
	}

	for (uint8_t i = y_s >> 3; i < (y_e >> 3) + 1; i++) {
		page_pos(x_s, i);
		for (uint8_t j = x_s; j < x_e + 1; j++) {
			lcd_write(WR_BYTE, dot_buff_read(i, j));
		}
	}
}
